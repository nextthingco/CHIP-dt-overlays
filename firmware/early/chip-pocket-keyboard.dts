// SPDX-License-Identifier: (GPL-2.0 OR MIT)
/*
 * PocketCHIP keyboard (TI TCA8418 on i2c1) as a device-tree overlay, ported to
 * mainline sun5i-r8-chip (Linux 6.12). Derived from NextThing's
 * dip-pocket-common.dtsi + dip-9d011a-1.dts (Maxime Ripard / Free Electrons /
 * NextThing Co, 2016).
 *
 * SCOPE: keyboard only. The full PocketCHIP overlay also brings up the LCD
 * panel, TCON, PWM backlight and touchscreen -- a separate, larger port.
 *
 * Mainline fixups vs the 4.4-era original:
 *   - i2c1 pin group renamed: i2c1_pins_a -> i2c1_pins
 *   - base &i2c1 ships status = "disabled" -> enable it + add pinctrl here
 * External labels used (must exist in the base dtb's __symbols__, i.e. the dtb
 * must be built with `dtc -@`): &i2c1, &i2c1_pins, &pio.
 */

/dts-v1/;
/plugin/;

#include <dt-bindings/input/input.h>
#include <dt-bindings/interrupt-controller/irq.h>

&i2c1 {
	#address-cells = <1>;
	#size-cells = <0>;
	pinctrl-names = "default";
	pinctrl-0 = <&i2c1_pins>;
	status = "okay";

	keyboard@34 {
		compatible = "ti,tca8418";
		reg = <0x34>;
		interrupt-parent = <&pio>;
		interrupts = <6 1 IRQ_TYPE_EDGE_FALLING>;	/* PG1 */

		keypad,num-rows = <6>;
		keypad,num-columns = <10>;
		keypad,autorepeat;

		linux,keymap = <
			MATRIX_KEY(0, 0, 13)
			MATRIX_KEY(0, 1, KEY_1)
			MATRIX_KEY(0, 2, KEY_2)
			MATRIX_KEY(0, 3, KEY_3)
			MATRIX_KEY(0, 4, KEY_4)
			MATRIX_KEY(0, 5, KEY_5)
			MATRIX_KEY(0, 6, KEY_6)
			MATRIX_KEY(0, 7, KEY_7)
			MATRIX_KEY(0, 8, KEY_8)
			MATRIX_KEY(0, 9, KEY_9)

			MATRIX_KEY(1, 0, KEY_Q)
			MATRIX_KEY(1, 1, KEY_W)
			MATRIX_KEY(1, 2, KEY_E)
			MATRIX_KEY(1, 3, KEY_R)
			MATRIX_KEY(1, 4, KEY_T)
			MATRIX_KEY(1, 5, KEY_Y)
			MATRIX_KEY(1, 6, KEY_U)
			MATRIX_KEY(1, 7, KEY_I)
			MATRIX_KEY(1, 8, KEY_O)
			MATRIX_KEY(1, 9, KEY_P)

			MATRIX_KEY(2, 0, KEY_A)
			MATRIX_KEY(2, 1, KEY_S)
			MATRIX_KEY(2, 2, KEY_D)
			MATRIX_KEY(2, 3, KEY_F)
			MATRIX_KEY(2, 4, KEY_G)
			MATRIX_KEY(2, 5, KEY_H)
			MATRIX_KEY(2, 6, KEY_J)
			MATRIX_KEY(2, 7, KEY_K)
			MATRIX_KEY(2, 8, KEY_L)
			MATRIX_KEY(2, 9, KEY_ENTER)

			MATRIX_KEY(3, 0, KEY_TAB)
			MATRIX_KEY(3, 1, KEY_Z)
			MATRIX_KEY(3, 2, KEY_X)
			MATRIX_KEY(3, 3, KEY_C)
			MATRIX_KEY(3, 4, KEY_V)
			MATRIX_KEY(3, 5, KEY_B)
			MATRIX_KEY(3, 6, KEY_N)
			MATRIX_KEY(3, 7, KEY_M)
			MATRIX_KEY(3, 8, KEY_UP)
			MATRIX_KEY(3, 9, KEY_DOWN)

			MATRIX_KEY(4, 0, KEY_ESC)
			MATRIX_KEY(4, 1, KEY_RIGHTALT)
			MATRIX_KEY(4, 2, KEY_LEFTALT)
			MATRIX_KEY(4, 3, KEY_SPACE)
			MATRIX_KEY(4, 4, KEY_RIGHTCTRL)
			MATRIX_KEY(4, 5, KEY_SLASH)
			MATRIX_KEY(4, 6, KEY_RIGHTSHIFT)
			MATRIX_KEY(4, 8, KEY_LEFT)
			MATRIX_KEY(4, 9, KEY_RIGHT)

			MATRIX_KEY(5, 0, KEY_LEFTSHIFT)
			MATRIX_KEY(5, 1, KEY_0)
			MATRIX_KEY(5, 2, KEY_KPMINUS)
			MATRIX_KEY(5, 3, KEY_BACKSPACE)
			MATRIX_KEY(5, 4, KEY_DOT)
		>;
	};
};
